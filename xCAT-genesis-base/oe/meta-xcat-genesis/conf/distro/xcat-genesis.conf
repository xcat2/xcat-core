## xCAT-genesis-base/oe/meta-xcat-genesis/conf/distro/xcat-genesis.conf
```bitbake
DISTRO = "xcat-genesis"
DISTRO_NAME = "xCAT Genesis"
DISTRO_VERSION = "0.1"
DISTRO_CODENAME = "cheetah"
LINUX_VERSION_EXTENSION = "-xCAT-genesis"
KERNEL_MODULE_PACKAGE_SUFFIX = "-${KERNEL_VERSION_PKG_NAME}"

TCLIBC = "glibc"
INIT_MANAGER = "systemd"

DISTRO_FEATURES_DEFAULTS = ""
DISTRO_FEATURES = "acl ipv4 ipv6 largefile pci seccomp"

PACKAGE_CLASSES = "package_ipk"
VIRTUAL-RUNTIME_syslog = ""
VIRTUAL-RUNTIME_base-utils-syslog = ""
VIRTUAL-RUNTIME_login_manager = "busybox"

NO_RECOMMENDATIONS = "1"

PACKAGECONFIG:pn-systemd = "acl kmod link-udev-shared randomseed seccomp set-time-epoch sysext sysusers zstd"
RDEPENDS:systemd:remove = "systemd-serialgetty util-linux-agetty"

PACKAGECONFIG:pn-networkmanager = "crypto-null libedit man-resolv-conf nmcli systemd"
PACKAGECONFIG:append:pn-iproute2 = " rdma"
NETWORKMANAGER_DHCP_DEFAULT:pn-networkmanager = "internal"
NETWORKMANAGER_DNS_RC_MANAGER_DEFAULT:pn-networkmanager = "symlink"
NETWORKMANAGER_FIREWALL_DEFAULT:pn-networkmanager = ""
```

## xCAT-genesis-base/oe/meta-xcat-genesis/conf/layer.conf
```bitbake
BBPATH .= ":${LAYERDIR}"

BBFILES += "${LAYERDIR}/recipes-*/*/*.bb \
            ${LAYERDIR}/recipes-*/*/*.bbappend"

BBFILE_COLLECTIONS += "xcat_genesis"
BBFILE_PATTERN_xcat_genesis = "^${LAYERDIR}/"
BBFILE_PRIORITY_xcat_genesis = "10"

LAYERDEPENDS_xcat_genesis = "core"
LAYERSERIES_COMPAT_xcat_genesis = "wrynose"
```

## xCAT-genesis-base/oe/meta-xcat-genesis/conf/machine/include/s390x/tune-s390x.inc
```bitbake
DEFAULTTUNE ?= "s390x"

TUNEVALID[m64] = "64-bit z/Architecture ABI"
TUNEVALID[bigendian] = "Big-endian byte order"
TUNEVALID[z10] = "IBM System z10 instruction set"

TUNE_ARCH = "s390x"
TUNE_PKGARCH = "${TUNE_PKGARCH:tune-${DEFAULTTUNE}}"
TUNE_CCARGS .= "${@bb.utils.contains('TUNE_FEATURES', 'm64', ' -m64', '', d)}"
TUNE_CCARGS .= "${@bb.utils.contains('TUNE_FEATURES', 'z10', ' -march=z10 -mtune=z10', '', d)}"

AVAILTUNES += "s390x"
TUNE_FEATURES:tune-s390x = "m64 bigendian z10"
BASE_LIB:tune-s390x = "lib64"
BASELIB:libc-glibc:s390x = "lib64"
TUNE_PKGARCH:tune-s390x = "s390x"
PACKAGE_EXTRA_ARCHS:tune-s390x = "s390x"

def xcat_genesis_s390x_siteinfo(archinfo, osinfo, targetinfo, d):
    archinfo["s390x"] = "endian-big bit-64"
    return archinfo, osinfo, targetinfo

SITEINFO_EXTRA_DATAFUNCS += "xcat_genesis_s390x_siteinfo"

def xcat_genesis_s390x_packageqa_machdata(machdata, d):
    machdata["linux"]["s390x"] = (22, 0, 0, False, 64)
    return machdata

PACKAGEQA_EXTRA_MACHDEFFUNCS += "xcat_genesis_s390x_packageqa_machdata"
```

## xCAT-genesis-base/oe/meta-xcat-genesis/conf/machine/xcat-genesis-aarch64.conf
```bitbake
#@TYPE: Machine
#@NAME: xCAT Genesis aarch64
#@DESCRIPTION: Generic ARMv8-A Genesis target

DEFAULTTUNE = "aarch64"
XCAT_GENESIS_ARCHITECTURE = "aarch64"
require conf/machine/include/arm/arch-arm64.inc
require conf/machine/include/qemu.inc

KERNEL_IMAGETYPE = "Image"
SERIAL_CONSOLES = "115200;ttyAMA0"
XCAT_GENESIS_CONSOLE_TTY = "ttyAMA0"

MACHINE_FEATURES_DEFAULTS = ""
MACHINE_FEATURES = "pci"
MACHINE_ESSENTIAL_EXTRA_RDEPENDS = ""
MACHINE_EXTRA_RRECOMMENDS = ""

IMAGE_FSTYPES = "cpio.gz ext4"

QB_SYSTEM_NAME = "qemu-system-aarch64"
QB_MACHINE = "-machine virt"
QB_CPU = "-cpu cortex-a57"
QB_SMP = "-smp 2"
QB_DEFAULT_FSTYPE = "ext4"
QB_KERNEL_CMDLINE_APPEND = "console=ttyAMA0"
QB_OPT_APPEND = ""
```

## xCAT-genesis-base/oe/meta-xcat-genesis/conf/machine/xcat-genesis-armv7hf.conf
```bitbake
#@TYPE: Machine
#@NAME: xCAT Genesis armv7hf
#@DESCRIPTION: ARMv7-A hard-float Genesis target

DEFAULTTUNE = "armv7ahf"
ARM_INSTRUCTION_SET = "arm"
XCAT_GENESIS_ARCHITECTURE = "armv7hf"
require conf/machine/include/arm/arch-armv7a.inc
require conf/machine/include/qemu.inc

KERNEL_IMAGETYPE = "zImage"
SERIAL_CONSOLES = "115200;ttyAMA0"
XCAT_GENESIS_CONSOLE_TTY = "ttyAMA0"

MACHINE_FEATURES_DEFAULTS = ""
MACHINE_FEATURES = "pci"
MACHINE_ESSENTIAL_EXTRA_RDEPENDS = ""
MACHINE_EXTRA_RRECOMMENDS = ""

IMAGE_FSTYPES = "cpio.gz ext4"

QB_SYSTEM_NAME = "qemu-system-arm"
QB_MACHINE = "-machine virt,highmem=off"
QB_CPU = "-cpu cortex-a15"
QB_SMP = "-smp 2"
QB_DEFAULT_FSTYPE = "ext4"
QB_KERNEL_CMDLINE_APPEND = "console=ttyAMA0"
QB_OPT_APPEND = ""
```

## xCAT-genesis-base/oe/meta-xcat-genesis/conf/machine/xcat-genesis-ppc64.conf
```bitbake
#@TYPE: Machine
#@NAME: xCAT Genesis ppc64
#@DESCRIPTION: Generic 64-bit big-endian PowerPC Genesis target

DEFAULTTUNE = "powerpc64"
XCAT_GENESIS_ARCHITECTURE = "ppc64"
require conf/machine/include/powerpc/arch-powerpc64.inc
require conf/machine/include/qemu.inc

MACHINEOVERRIDES =. "qemuppc64:"

KERNEL_IMAGETYPE = "vmlinux"
SERIAL_CONSOLES = "115200;hvc0"
XCAT_GENESIS_CONSOLE_TTY = "hvc0"

require conf/machine/include/xcat-genesis-base.inc
MACHINE_FEATURES = "pci"
MACHINE_ESSENTIAL_EXTRA_RDEPENDS = ""

QB_SYSTEM_NAME = "qemu-system-ppc64"
QB_MACHINE = "-machine pseries"
QB_CPU = "-cpu POWER8"
QB_SMP = "-smp 2"
QB_KERNEL_CMDLINE_APPEND = "console=hvc0 nohugevmalloc"
QB_OPT_APPEND = ""
```

## xCAT-genesis-base/oe/meta-xcat-genesis/conf/machine/xcat-genesis-ppc64le.conf
```bitbake
#@TYPE: Machine
#@NAME: xCAT Genesis ppc64le
#@DESCRIPTION: POWER8 little-endian Genesis target

DEFAULTTUNE = "ppc64p8le"
XCAT_GENESIS_ARCHITECTURE = "ppc64le"
require conf/machine/include/powerpc/tune-power8.inc
require conf/machine/include/qemu.inc

MACHINEOVERRIDES =. "qemuppc64:"

KERNEL_IMAGETYPE = "vmlinux"
SERIAL_CONSOLES = "115200;hvc0"
XCAT_GENESIS_CONSOLE_TTY = "hvc0"

require conf/machine/include/xcat-genesis-base.inc
MACHINE_FEATURES = "pci"
MACHINE_ESSENTIAL_EXTRA_RDEPENDS = ""

QB_SYSTEM_NAME = "qemu-system-ppc64"
QB_MACHINE = "-machine pseries"
QB_CPU = "-cpu POWER8"
QB_SMP = "-smp 2"
QB_KERNEL_CMDLINE_APPEND = "console=hvc0 nohugevmalloc"
QB_OPT_APPEND = ""
```

## xCAT-genesis-base/oe/meta-xcat-genesis/conf/machine/xcat-genesis-riscv64.conf
```bitbake
#@TYPE: Machine
#@NAME: xCAT Genesis riscv64
#@DESCRIPTION: RV64GC Genesis target

DEFAULTTUNE = "riscv64"
XCAT_GENESIS_ARCHITECTURE = "riscv64"
require conf/machine/include/riscv/qemuriscv.inc

KERNEL_IMAGETYPE = "Image"
KERNEL_IMAGETYPES = ""
SERIAL_CONSOLES = "115200;ttyS0"
XCAT_GENESIS_CONSOLE_TTY = "ttyS0"

MACHINE_FEATURES_DEFAULTS = ""
MACHINE_FEATURES = "pci"
MACHINE_ESSENTIAL_EXTRA_RDEPENDS = ""
MACHINE_EXTRA_RRECOMMENDS = ""

IMAGE_FSTYPES = "cpio.gz ext4"
EXTRA_IMAGEDEPENDS = "opensbi"
RISCV_SBI_PLAT = "generic"

QB_SYSTEM_NAME = "qemu-system-riscv64"
QB_MACHINE = "-machine virt"
QB_CPU = "-cpu rv64"
QB_SMP = "-smp 2"
QB_DEFAULT_BIOS = "fw_jump.elf"
QB_DEFAULT_FSTYPE = "ext4"
QB_KERNEL_CMDLINE_APPEND = "console=ttyS0 earlycon=sbi"
QB_OPT_APPEND = ""
```

## xCAT-genesis-base/oe/meta-xcat-genesis/conf/machine/xcat-genesis-s390x.conf
```bitbake
#@TYPE: Machine
#@NAME: xCAT Genesis s390x
#@DESCRIPTION: QEMU s390x Genesis target

DEFAULTTUNE = "s390x"
XCAT_GENESIS_ARCHITECTURE = "s390x"
require conf/machine/include/s390x/tune-s390x.inc
require conf/machine/include/qemu.inc

ARCH:s390x = "s390"
QEMU_TARGETS:append = " s390x"

KERNEL_IMAGETYPE = "bzImage"
SERIAL_CONSOLES = "115200;ttysclp0"
XCAT_GENESIS_CONSOLE_TTY = "ttysclp0"

MACHINE_FEATURES_DEFAULTS = ""
MACHINE_FEATURES = ""
MACHINE_ESSENTIAL_EXTRA_RDEPENDS = ""
MACHINE_EXTRA_RRECOMMENDS = ""

IMAGE_FSTYPES = "cpio.gz ext4"

QB_SYSTEM_NAME = "qemu-system-s390x"
QB_MACHINE = "-machine s390-ccw-virtio"
# TCG lacks optional z10 facilities, so disable them while retaining the z10 instruction floor.
QB_CPU = "-cpu z10EC-base,msa=off,msa1=off,dfp=off,dfphp=off,parseh=off,hfpue=off,hfpm=off,pfpo=off,dateh2=off,csske=off,asnlxr=off,tods=off"
QB_SMP = "-smp 2"
QB_MEM = "-m 4096"
QB_DEFAULT_FSTYPE = "ext4"
QB_KERNEL_CMDLINE_APPEND = "console=ttysclp0"
QB_NETWORK_DEVICE = "-device virtio-net-ccw,netdev=net0,mac=@MAC@"
QB_ROOTFS_OPT = "-drive id=disk0,file=@ROOTFS@,if=none,format=raw -device virtio-blk-ccw,drive=disk0"
QB_RNG = "-object rng-random,filename=/dev/urandom,id=rng0 -device virtio-rng-ccw,rng=rng0"
QB_OPT_APPEND = ""
```

## xCAT-genesis-base/oe/meta-xcat-genesis/conf/machine/xcat-genesis-x86-64.conf
```bitbake
#@TYPE: Machine
#@NAME: xCAT Genesis x86_64
#@DESCRIPTION: x86_64-v1 Genesis target

PREFERRED_PROVIDER_virtual/kernel ?= "linux-yocto"
RDEPENDS:${KERNEL_PACKAGE_NAME}-base = ""

DEFAULTTUNE = "x86-64"
XCAT_GENESIS_ARCHITECTURE = "x86_64"
require conf/machine/include/x86/arch-x86.inc
require conf/machine/include/x86/qemuboot-x86.inc

KERNEL_IMAGETYPE = "bzImage"
SERIAL_CONSOLES = "115200;ttyS0"
XCAT_GENESIS_CONSOLE_TTY = "ttyS0"

MACHINE_FEATURES_DEFAULTS = ""
MACHINE_FEATURES = "pci"
MACHINE_EXTRA_RRECOMMENDS = ""

IMAGE_FSTYPES = "cpio.gz ext4"

QB_SYSTEM_NAME = "qemu-system-x86_64"
QB_DEFAULT_FSTYPE = "ext4"
QB_CPU:x86-64 = "-cpu qemu64 -machine q35,i8042=off"
QB_CPU_KVM:x86-64 = "-cpu qemu64 -machine q35,i8042=off"
QB_KERNEL_CMDLINE_APPEND = "console=ttyS0"
```

## xCAT-genesis-builder/oe/meta-xcat-genesis/conf/machine/xcat-genesis-x86.conf
```bitbake
#@TYPE: Machine
#@NAME: xCAT Genesis x86
#@DESCRIPTION: i686 32-bit Genesis target

DEFAULTTUNE = "i686"
XCAT_GENESIS_ARCHITECTURE = "x86"
require conf/machine/include/x86/tune-i686.inc
require conf/machine/include/qemu.inc
require conf/machine/include/x86/qemuboot-x86.inc

KERNEL_IMAGETYPE = "bzImage"
SERIAL_CONSOLES = "115200;ttyS0"
XCAT_GENESIS_CONSOLE_TTY = "ttyS0"

MACHINE_FEATURES_DEFAULTS = ""
MACHINE_FEATURES = "pci"
MACHINE_ESSENTIAL_EXTRA_RDEPENDS = ""
MACHINE_EXTRA_RRECOMMENDS = ""

IMAGE_FSTYPES = "cpio.gz ext4"

QB_SYSTEM_NAME = "qemu-system-i386"
QB_DEFAULT_FSTYPE = "ext4"
QB_KERNEL_CMDLINE_APPEND = "console=ttyS0"
```
